## boards/amd/mbv32/Kconfig.defconfig
```kconfig
#
# Copyright (c) 2024 Advanced Micro Devices, Inc.
#
# SPDX-License-Identifier: Apache-2.0
#
if BOARD_MBV32

config FLASH_BASE_ADDRESS
    default 0x30000000

config SRAM_BASE_ADDRESS
    default 0x30000000

endif
```

## boards/amd/mbv32/mbv32_defconfig
```kconfig
#
# Copyright (c) 2024 Advanced Micro Devices, Inc.
#
# SPDX-License-Identifier: Apache-2.0
#

CONFIG_XIP=n
CONFIG_FLASH=n
CONFIG_HEAP_MEM_POOL_SIZE=4096
```

## drivers/mbox/Kconfig.xlnx
```kconfig
# Copyright (c) 2025 Dang Cao Minh <dangcaominhheo@gmail.com>
# SPDX-License-Identifier: Apache-2.0

config MBOX_XILINX
	bool "AXI MBOX XILINX driver"
	depends on DT_HAS_XLNX_MAILBOX_ENABLED
	help
	  AXI MBOX XILINX driver for microblaze riscv core
```

## dts/bindings/mbox/xlnx,mailbox.yaml
```yaml
# Copyright (c) 2025 Dang Cao Minh <dangcaominhheo@gmail.com>
# SPDX-License-Identifier: Apache-2.0

description: AXI MBOX XILINX

compatible: "xlnx,mailbox"

include: [base.yaml, mailbox-controller.yaml]

properties:
  reg:
    required: true

  interrupts:
    required: true

  xlnx,recv-it:
    type: int
    default: 16
    required: false
    description: Receive Interrupt Threshold

  xlnx,send-it:
    type: int
    default: 16
    required: false
    description: Send Interrupt Threshold
  xlnx,ip-name:
    type: string
  xlnx,name:
    type: string

interrupt-cells:
  - irq
  - priority
```

## dts/bindings/serial/xlnx,xuartps.yaml
```yaml
description: Xilinx PS UART

compatible: "xlnx,xuartps"

include: [uart-controller.yaml, pinctrl-device.yaml]

properties:
  reg:
    required: true

  xlnx,clock-freq:
    type: int
    description: Xilinx clock frequency
  
  xlnx,has-modem:
    type: int
    description: Indicates if the UART has modem control signals
  xlnx,ip-name:
    type: string
    description: IP core name
    
  xlnx,name:
    type: string
    description: Instance name
    
  xlnx,uart-clk-freq-hz:
    type: int
    description: UART clock frequency in Hz
    
  port-number:
    type: int
    description: Port number
    
  cts-override:
    type: boolean
    description: Override CTS signal
```

## soc/xlnx/mbv32/Kconfig.defconfig
```kconfig
#
# Copyright (c) 2024 Advanced Micro Devices, Inc.
#
# SPDX-License-Identifier: Apache-2.0
#


if SOC_MBV32

config MBV_CSR_DATA_WIDTH
  int "Select Control/Status register width"
  default 32

config SYS_CLOCK_HW_CYCLES_PER_SEC
  default 100000000

config NUM_IRQS
  default 16

endif
```
